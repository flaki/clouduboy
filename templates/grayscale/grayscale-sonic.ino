#include <SPI.h>
#include "Arduboy.h"

Arduboy arduboy;



PROGMEM const unsigned char gfx_blobs_sonic[] = { /*16x16x4*/
  0x00, 0x00, 0x00, 0x00, 0x00, 0x00, 0x00, 0x00,
  0x00, 0x00, 0xe0, 0xc0, 0x00, 0x00, 0x00, 0x00,
  0x00, 0x00, 0x00, 0x00, 0x00, 0x00, 0x00, 0x00,
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  0xc0, 0xc0, 0x00, 0x00, 0x00, 0x00, 0x00, 0x00
};

const byte GFX_BLOBS_SONIC_WIDTH = 16;
const byte GFX_BLOBS_SONIC_HEIGHT = 16;
const byte GFX_BLOBS_SONIC_FRAMES = 4;
const byte GFX_BLOBS_SONIC_FRAMESIZE = 32;



void setup() {
  arduboy.begin();
}

void loop() {
  arduboy.clear();
  int i = 0;

  while(1) {

    arduboy.drawBitmap( 16, 16, gfx_blobs_sonic + GFX_BLOBS_SONIC_FRAMESIZE*i, GFX_BLOBS_SONIC_WIDTH, GFX_BLOBS_SONIC_HEIGHT, WHITE );
	  arduboy.display();

    if (++i >= GFX_BLOBS_SONIC_FRAMES) {
      i = 0;
      //arduboy.clear();
      delay(5);
      arduboy.fillRect( 16,16, 16,16, BLACK);
    } else if (i>0) {
      delay(7);
    }
  }
}
