#include <SPI.h>
#include "Arduboy.h"

#include <EEPROM.h>

#include <avr/pgmspace.h>

Arduboy arduboy;

// frame counter
unsigned int frame = 0;

// general use string buffer
char text[16];


// RUHR.JS EDITION

PROGMEM const unsigned char rjs[] = { /*78x15*/ 0xfe, 0x1, 0xfe, 0x2, 0x85, 0x85, 0x5, 0xc5, 0xb9, 0xc2, 0x3c, 0x0, 0x0, 0x0, 0xfe, 0x1, 0xfe, 0x0, 0x0, 0x0, 0x0, 0x0, 0xfe, 0x1, 0xfe, 0x0, 0x0, 0x0, 0x0, 0xfe, 0x1, 0x7e, 0x40, 0x40, 0x40, 0x40, 0x80, 0xfe, 0x1, 0xfe, 0x0, 0x0, 0x0, 0x0, 0xfe, 0x1, 0xfe, 0x2, 0x85, 0x85, 0x5, 0xc5, 0xbb, 0xc6, 0x7c, 0x0, 0x0, 0x0, 0x0, 0x0, 0x0, 0xfe, 0x1, 0xfe, 0x0, 0x0, 0x0, 0x1c, 0x26, 0x5a, 0x97, 0xa0, 0xa3, 0xa5, 0x45, 0xcb, 0x8a, 0xc, 0x3f, 0x40, 0x3f, 0x1, 0x2, 0x5, 0xb, 0x16, 0x2c, 0x58, 0x30, 0x0, 0x0, 0x0, 0x1, 0x1b, 0x29, 0x28, 0x50, 0x50, 0x50, 0x28, 0x27, 0x18, 0x7, 0x0, 0x0, 0x0, 0x0, 0x3f, 0x40, 0x3f, 0x1, 0x1, 0x1, 0x1, 0x0, 0x3f, 0x40, 0x3f, 0x0, 0x0, 0x0, 0x0, 0x3f, 0x40, 0x3f, 0x1, 0x2, 0x5, 0xb, 0x16, 0x2c, 0x58, 0x30, 0x0, 0x0, 0x20, 0x50, 0x50, 0x28, 0x27, 0x10, 0xf, 0x0, 0x0, 0x0, 0xc, 0x14, 0x2c, 0x28, 0x50, 0x50, 0x60, 0x1b, 0x34, 0x39, 0xf };

PROGMEM const unsigned char rjs_logo[] = { /*39x36*/ 0x0, 0x0, 0x0, 0x0, 0xc0, 0x60, 0xb0, 0x50, 0x28, 0x2c, 0x14, 0x8a, 0x8a, 0xa5, 0xa5, 0xa5, 0xa5, 0xa5, 0xa5, 0xa5, 0xa5, 0xa5, 0xa5, 0xa5, 0xa5, 0xa5, 0x8a, 0x8a, 0x14, 0x2c, 0x28, 0x50, 0xb0, 0x60, 0xc0, 0x0, 0x0, 0x0, 0x0, 0xc0, 0x38, 0xc6, 0x3b, 0x4, 0x3, 0x0, 0x0, 0x0, 0x0, 0xc1, 0x62, 0x32, 0xfa, 0xa, 0xfa, 0x32, 0x62, 0x42, 0x2, 0x42, 0x62, 0x32, 0xfa, 0xa, 0xfa, 0x32, 0x62, 0xc1, 0x0, 0x0, 0x0, 0x0, 0x3, 0x4, 0x3b, 0xc6, 0x38, 0xc0, 0xff, 0x0, 0xff, 0x0, 0x0, 0x0, 0x0, 0x0, 0x0, 0x0, 0x1, 0x83, 0x70, 0x8f, 0x70, 0xd, 0x5, 0x7d, 0x7d, 0x5, 0x7d, 0x7d, 0x5, 0xd, 0x70, 0x8f, 0x70, 0x83, 0x1, 0x0, 0x0, 0x0, 0x0, 0x0, 0x0, 0x0, 0xff, 0x0, 0xff, 0x0, 0x7, 0x18, 0x27, 0x5c, 0xb0, 0xe0, 0x0, 0xc0, 0x30, 0xce, 0x31, 0xe, 0x1, 0x0, 0x1, 0x1, 0xff, 0xff, 0x1, 0xff, 0xff, 0x1, 0x1, 0x0, 0x1, 0xe, 0x31, 0xce, 0x30, 0xc0, 0x0, 0xe0, 0xb0, 0x5c, 0x27, 0x18, 0x7, 0x0, 0x0, 0x0, 0x0, 0x0, 0x0, 0x0, 0x0, 0xe, 0x9, 0x6, 0x1, 0x0, 0x0, 0x0, 0x0, 0x0, 0x0, 0x0, 0x0, 0x0, 0x0, 0x0, 0x0, 0x0, 0x0, 0x0, 0x0, 0x0, 0x1, 0x6, 0x9, 0xe, 0x0, 0x0, 0x0, 0x0, 0x0, 0x0, 0x0 };


// Obstacle: Cactus (17 x 24 px)
PROGMEM const unsigned char cactus_1[] = { /* 12x24 */
  0x00, 0x00, 0x00, 0x00, 0xfe, 0xff, 0xff, 0xfe, 0x00, 0xc0, 0xc0, 0x80,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 0x00
};

// Backdrop sprite: Cloud (17 x 8 px)
PROGMEM const unsigned char cloud_1[] = { /* 17x8 */
  0x1c, 0x22, 0x22, 0x22, 0x24, 0x10, 0x12, 0x2a, 0x21, 0x41, 0x41, 0x41, 0x42, 0x4a, 0x24, 0x24, 0x18
};

// Dino Animation

// Main body sprite (20 x 18 px)
PROGMEM const unsigned char dino_top[] = { /* 20x18 */
  0x00, 0x00, 0x00, 0x00, 0x00, 0x00, 0x00, 0x00, 0x00, 0x00, 0xfe, 0xff,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 0x00
};

// TODO: make this a single, 3-frame sprite
// Legs Animation (20 x 5px, 3 frames)
PROGMEM const unsigned char dino_leg_0[] = { /* 20x5 */
  0x00, 0x00, 0x00, 0x00, 0x01, 0x1f, 0x17, 0x03, 0x01, 0x03, 0x1f, 0x10, 0x00, 0x00, 0x00, 0x00, 0x00, 0x00, 0x00, 0x00
};
PROGMEM const unsigned char dino_leg_1[] = { /* 20x5 */
  0x00, 0x00, 0x00, 0x00, 0x01, 0x0f, 0x0b, 0x01, 0x01, 0x03, 0x1f, 0x10, 0x00, 0x00, 0x00, 0x00, 0x00, 0x00, 0x00, 0x00
};
PROGMEM const unsigned char dino_leg_2[] = { /* 20x5 */
  0x00, 0x00, 0x00, 0x00, 0x01, 0x1f, 0x17, 0x03, 0x01, 0x03, 0x0f, 0x08, 0x00, 0x00, 0x00, 0x00, 0x00, 0x00, 0x00, 0x00
};

// Dino tumble - game over (30 x 18 px)
PROGMEM const unsigned char dino_tumble[] = { /* 30x18 */
  0x00, 0x00, 0x00, 0x00, 0x00, 0x00, 0x00, 0x00, 0x00, 0x00, 0x00, 0x00,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 0x01
};



void intro()
{
  for(int i = -8; i < 39; i = i + 2)
  {
    arduboy.clear();
    arduboy.drawBitmap(44, 0, rjs_logo, 39,36, WHITE );

    arduboy.drawBitmap(25, i, rjs, 78,15, WHITE );
    arduboy.display();
    delay(16);
  }

  arduboy.tunes.tone(987, 120);
  delay(120);
  arduboy.tunes.tone(1318, 400);

  arduboy.setCursor(42, 55);
  arduboy.print("presents");
  arduboy.display();

  delay(1000);


  int y = 12;
  arduboy.drawBitmap(54-2, y-1,    dino_top,   20,18, BLACK);
  arduboy.drawBitmap(54+1, y+1,    dino_top,   20,18, BLACK);

  for (int i=0; i<12; ++i) {
    int rx = random(0,2)-1;
    int ry = random(0,2)-1;

    arduboy.drawBitmap(rx+ 54, ry+ y,    dino_top,   20,18, WHITE);
    arduboy.drawBitmap(rx+ 54, ry+ y+18, dino_leg_0, 20, 5, WHITE);
    arduboy.display();
    delay(16+i);

    arduboy.drawBitmap(rx+ 54+(i%2?i:-i)/2, ry+ y+(i%2?i:-i)/2,    dino_top,   20,18, BLACK);
    arduboy.drawBitmap(rx+ 54+(i%2?i:-i)/2, ry+ y+(i%2?i:-i)/2,    dino_leg_0,   20,18, BLACK);
    arduboy.display();
    delay(30-i);
  }

  for(; y < 41; y += 1+y/10)
  {
    arduboy.clear();
    arduboy.drawBitmap(44, 0,  rjs_logo, 39,36, WHITE );
    arduboy.drawBitmap(25, 38, rjs,      78,15, WHITE );

	arduboy.setCursor(42, 55);
    arduboy.print("pr   nts");
	arduboy.setCursor(54, 55 + (y>32 ? y-32 : 0));
    arduboy.print("ese");

      arduboy.drawBitmap(54-2, y-1,    dino_top,   20,18, BLACK);
      arduboy.drawBitmap(54+1, y+1,    dino_top,   20,18, BLACK);
      arduboy.drawBitmap(54, y,    dino_top,   20,18, WHITE);
      arduboy.drawBitmap(54, y+18, dino_leg_0, 20, 5, WHITE);

    arduboy.display();
    delay(16);
  }


  arduboy.tunes.tone(246, 20);
  delay(20);
  arduboy.tunes.tone(174, 40);

  delay(2000);

  y=40;
  for (int i = 0; i < 64; ++i) {
    arduboy.drawLine(0, i<32 ? i*2 : 127-i*2, 127,i<32 ? i*2 : 127-i*2, BLACK);
    int z = i<54 ? i : 54;

      arduboy.drawBitmap(54-z, y,    dino_top,   20,18, WHITE);
      arduboy.drawBitmap(54-z, y+18, dino_leg_0, 20, 5, WHITE);

    arduboy.display();

    arduboy.drawBitmap(54-z, y,    dino_top,   20,18, BLACK);
    arduboy.drawBitmap(54-z, y+18, dino_leg_0, 20, 5, BLACK);

    delay(16);
  }

}



// distance ran
int d, delta;

int cloud_1_y;

int d_jump, d_jump_t;

int d_run;
int d_tumble_t;

int ox;

void setup()
{
  arduboy.begin();
  arduboy.setFrameRate(60);
  intro();
  d = 0;
  delta = 0;

  cloud_1_y = 2;

  d_jump = 0;
  d_jump_t = 0;

  d_tumble_t = 0;
  d_run = 0;

  ox = 130;
}

void loop()
{
  if (!d_run && arduboy.pressed(A_BUTTON)) {
    d_run = 1;
  }

  if (d_tumble_t && arduboy.pressed(A_BUTTON)) {
    setup();
    return;
  }

  ++frame;
  if (frame>16000) frame = 0;

  // increase distance whilst running
  if (d_run && (++delta > 4)) {
    delta = 0; ++d;
  }

  // obstacles
  if (d_run) {
    ox -= (frame%2)*(d/100) + 2;
    if (ox < -15) ox += 140 + random(0,60);
  }

  // jump!
  if (!d_jump_t && arduboy.pressed(A_BUTTON)) {
    d_jump_t = 1;
    d_jump=5;

    arduboy.tunes.tone(440, 40);

  } else if (d_jump_t) {
    if (d_jump_t == 3) arduboy.tunes.tone(880, 80);

    ++d_jump_t;

    if (d_jump_t<6) {
      d_jump +=6;
    } else if (d_jump_t<9) {
      d_jump +=2;
    } else if (d_jump_t<13) {
      d_jump +=1;
    } else if (d_jump_t == 16 || d_jump_t == 18) {
      d_jump +=1;
    } else if (d_jump_t == 20 || d_jump_t == 22) {
      d_jump -=1;
    } else if (d_jump_t>38) {
      d_jump = 0;
      d_jump_t = 0;
    } else if (d_jump_t>32) {
      d_jump -=6;
    } else if (d_jump_t>29) {
      d_jump -=2;
    } else if (d_jump_t>25) {
      d_jump -=1;
    }
  }

  // hit detect
  if (!d_tumble_t && ox > -10 && ox <16 && d_jump_t < 14) {
    d_tumble_t = 1;
  }

  if (d_tumble_t) {
    if (d_tumble_t == 1) {
      arduboy.tunes.tone(246, 80);
    } else if (d_tumble_t == 6) {
      arduboy.tunes.tone(174, 200);
    }

    ++d_tumble_t;
    if (d_jump > -4) {
      d_jump -= 1;
      ox -= 1;
    } else {
      d_run = 0;
    }
  }

  arduboy.clear();


  // hud
  arduboy.setCursor(0, 0);
  sprintf(text,"DIST: %d",d);
  arduboy.print(text);


  // parallax clouds
  arduboy.drawBitmap(128 -(d%128),cloud_1_y,cloud_1,17,7,WHITE);

  if (d%128 == 0) {
    cloud_1_y = random(0,10);
  }

  // terrain
  if (d_jump > 4) {
    arduboy.drawLine(0,60,127,60,WHITE);
  } else {
    arduboy.drawLine(0,60,3,60,WHITE);
    arduboy.drawLine(12,60,127,60,WHITE);
  }

  // obstacles
  arduboy.drawBitmap(ox,40,cactus_1,12,24,WHITE);

  // dino
  int dy = 40-d_jump;

  // tumbles!
  if (d_tumble_t) {
    arduboy.drawBitmap(0,dy,dino_tumble,30,18,WHITE);

  // runs!
  } else {
    arduboy.drawBitmap(0,dy,dino_top,20,18,WHITE);

    // Run, Dino, Run!
    if (d_run && !d_jump) {
      if ((frame%8)/4) {
        arduboy.drawBitmap(0,dy+18,dino_leg_1,20,5,WHITE);
      } else {
        arduboy.drawBitmap(0,dy+18,dino_leg_2,20,5,WHITE);
      }
    } else {
      arduboy.drawBitmap(0,dy+18,dino_leg_0,20,5,WHITE);
    }
  }

  arduboy.display();
  delay(16);
}
